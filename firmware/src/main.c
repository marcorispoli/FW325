
#include <stddef.h>                     // Defines NULL
#include <stdbool.h>                    // Defines true
#include <stdlib.h>                     // Defines EXIT_FAILURE
#include "definitions.h"                // SYS function prototypes

#include "application.h"
#include "Protocol/protocol.h"
#include "Motors/motors.h"


 /** 
     * \defgroup appMainModule  Main Module 
     * \ingroup applicationModule
     *     
     * This section implements the data structures of the module
     *  @{
     */

static uint8_t trigger_time = 0;

#define _1024_ms_TriggerTime 0x1
#define _7820_us_TriggerTime 0x2
#define _15_64_ms_TriggerTime 0x4

struct {
  int period;
  int duty;
  bool status;
}powerLight;

void powerLightInit(int period){
    uc_LAMP_ON_Set();
    powerLight.status = false;
    powerLight.duty = 0;
    powerLight.period = period;
    TCC0_PWM24bitPeriodSet(period); // 150 = 20-KHz
}

void setPowerLight(bool status, int duty){
    
    // Only on changed status
    if((status == powerLight.status) && (powerLight.duty == duty))  return;    
    powerLight.status = status; 
    powerLight.duty = duty;
    
    
    if(status){
        uc_LAMP_ON_Clear(); 

        // Sets the Duty cycle
        TCC0_PWM24bitDutySet(TCC0_CHANNEL0, powerLight.period * duty / 100);
        TCC0_PWMStart();

    }else{
        uc_LAMP_ON_Set();
        TCC0_PWMStop();
    }
}
/**
 * This is the callback generated by the RTC module at the interrupt event.
 * 
 * @param intCause this is the cause of the interrupt event;
 * @param context this is the data pointer passed with the  RTC_Timer32CallbackRegister() routine;
 */
static void rtcEventHandler (RTC_TIMER32_INT_MASK intCause, uintptr_t context)
{
    // Periodic Interval Handler: Freq = 1024 / 2 ^ (n+3)
    
    if (intCause & RTC_TIMER32_INT_MASK_PER0) trigger_time |= _7820_us_TriggerTime;  // 7.82ms Interrupt
    if (intCause & RTC_TIMER32_INT_MASK_PER1) trigger_time |= _15_64_ms_TriggerTime; // 15.64ms Interrupt
    if (intCause & RTC_TIMER32_INT_MASK_PER7) trigger_time |= _1024_ms_TriggerTime;  // 1024 ms Interrupt
    
}




int main ( void )
{
    /* Initialize all modules */
    SYS_Initialize ( NULL );

    // Registers the RTC interrupt routine to the RTC module
    RTC_Timer32CallbackRegister(rtcEventHandler, 0);
    RTC_Timer32Start(); // Start the RTC module
    
    // Application Protocol initialization
    ApplicationProtocolInit();
    
    // ADC Initialization
    ADC0_Enable();
    
    motorInit();
    
    // Sets the the frequency of PWM to 20 kHz
    powerLightInit(150);

    
    while ( true )
    {
        /* Maintain state machines of all polled MPLAB Harmony modules. */
        SYS_Tasks ( );
                
        // Protocol management
        ApplicationProtocolLoop();
        
    
        if(trigger_time & _1024_ms_TriggerTime){
            trigger_time &=~ _1024_ms_TriggerTime;            
            motor1sLoop();   
            updateDataRegister((void*)&DataGeneralRegister);
            setPowerLight(DataGeneralRegister.light_ena, DataGeneralRegister.light_duty);            
            VITALITY_LED_Toggle(); 
        }        
 
        // Timer events activated into the RTC interrupt
        if(trigger_time & _7820_us_TriggerTime){
            trigger_time &=~ _7820_us_TriggerTime;
            motorLoop();
        }

        if(trigger_time & _15_64_ms_TriggerTime){
            trigger_time &=~ _15_64_ms_TriggerTime;      
            
           
        }
    }

    /* Execution should not come here during normal operation */

    return ( EXIT_FAILURE );
}

/** @}*/
/*******************************************************************************
 End of File
*/

