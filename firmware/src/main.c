#define _MAIN_C
#include <stddef.h>                     // Defines NULL
#include <stdbool.h>                    // Defines true
#include <stdlib.h>                     // Defines EXIT_FAILURE
#include "definitions.h"                // SYS function prototypes

#include "application.h"
#include "Protocol/protocol.h"
#include "Motors/motors.h"
#include "main.h"

 /** 
     * \defgroup appMainModule  Main Module 
     * \ingroup applicationModule
     *     
     * This section implements the data structures of the module
     *  @{
     */

static uint8_t trigger_time = 0;

#define _1024_ms_TriggerTime    0x1
#define _7820_us_TriggerTime    0x2
#define _15_64_ms_TriggerTime   0x4
#define _128_ms_TriggerTime     0x8

static void XScrollDetection(void);
static void NeedleIdDetection(void);
static void MotorPowerSupplyDetection(void);
static void GetSHSensor(void);
static void YFlipDetection(void);
static void KeyboardHandler(void);
static void KeyboardHandler(void);

struct {
  int period;
  int duty;
  bool status;
}powerLight;


void powerLightInit(int period){
    uc_LAMP_ON_Set();
    powerLight.status = false;
    powerLight.duty = 0;
    powerLight.period = period;
    TCC0_PWM24bitPeriodSet(period); // 150 = 20-KHz
}

/*
void setPowerLight(bool status, int duty){
    
    // Only on changed status
    if((status == powerLight.status) && (powerLight.duty == duty))  return;    
    powerLight.status = status; 
    powerLight.duty = duty;
    
    
    if(status){
        uc_LAMP_ON_Clear(); 

        // Sets the Duty cycle
        TCC0_PWM24bitDutySet(TCC0_CHANNEL0, powerLight.period * duty / 100);
        TCC0_PWMStart();

    }else{
        uc_LAMP_ON_Set();
        TCC0_PWMStop();
    }
}*/

/**
 * This is the callback generated by the RTC module at the interrupt event.
 * 
 * @param intCause this is the cause of the interrupt event;
 * @param context this is the data pointer passed with the  RTC_Timer32CallbackRegister() routine;
 */
static void rtcEventHandler (RTC_TIMER32_INT_MASK intCause, uintptr_t context)
{
    // Periodic Interval Handler: Freq = 1024 / 2 ^ (n+3)
    
    if (intCause & RTC_TIMER32_INT_MASK_PER0) trigger_time |= _7820_us_TriggerTime;  // 7.82ms Interrupt
    if (intCause & RTC_TIMER32_INT_MASK_PER1) trigger_time |= _15_64_ms_TriggerTime; // 15.64ms Interrupt
    if (intCause & RTC_TIMER32_INT_MASK_PER4) trigger_time |= _128_ms_TriggerTime;   // 128 ms Interrupt
    if (intCause & RTC_TIMER32_INT_MASK_PER7) trigger_time |= _1024_ms_TriggerTime;  // 1024 ms Interrupt
    
}




int main ( void )
{
    /* Initialize all modules */
    SYS_Initialize ( NULL );

    // Registers the RTC interrupt routine to the RTC module
    RTC_Timer32CallbackRegister(rtcEventHandler, 0);
    RTC_Timer32Start(); // Start the RTC module
    
    // Application Protocol initialization
    ApplicationProtocolInit();
    
    // ADC Initialization
    ADC0_Enable();
    ADC1_Enable();
    
    motorInit();
    
    // Sets the the frequency of PWM to 20 kHz
    // Funzione comunque non più utilizzata in quest'applicazione 
    powerLightInit(150);

    
    while ( true )
    {
        /* Maintain state machines of all polled MPLAB Harmony modules. */
        SYS_Tasks ( );
                
        // Protocol management
        ApplicationProtocolLoop();
        
    
        if(trigger_time & _1024_ms_TriggerTime){
            trigger_time &=~ _1024_ms_TriggerTime;            
            motor1sLoop();         
            MotorPowerSupplyDetection();
            VITALITY_LED_Toggle(); 
        }        
 
        // Timer events activated into the RTC interrupt
        if(trigger_time & _7820_us_TriggerTime){
            trigger_time &=~ _7820_us_TriggerTime;
            motorLoop();
        }

        if(trigger_time & _15_64_ms_TriggerTime){
            trigger_time &=~ _15_64_ms_TriggerTime;      
            
            GetSHSensor();
           
        }
        
        if(trigger_time & _128_ms_TriggerTime){
            trigger_time &=~ _128_ms_TriggerTime;      
            
            XScrollDetection();
            NeedleIdDetection();
            YFlipDetection();
            KeyboardHandler();
        }
        
    }

    /* Execution should not come here during normal operation */

    return ( EXIT_FAILURE );
}

#define XSCROLL_DEBOUNCE 4 
void XScrollDetection(void){
    static int debounce = XSCROLL_DEBOUNCE; // About 500ms

    STATUS_XSCROLL_t xscroll_stat;
    
    // Reads the sensor
    ADC1_ChannelSelect( ADC_POSINPUT_AIN1, ADC_NEGINPUT_GND );
    ADC1_ConversionStart();
    while(!ADC1_ConversionStatusGet());
    deviceStruct.sensors.xscroll = (int) ADC1_ConversionResultGet();    
    StatusAnalogRegister.X_SCROLL = deviceStruct.sensors.xscroll;
    
    // Identification Table
    // Vuc = VBoard 0.545 ->
    // ON = OBSCURED SLOT
    // OC1 - OC2 - OC3 - VBOARD - VuC   - 8bit ADC
    // OFF - OFF - OFF = 5V     = 2.72  - 210
    // OFF - OFF - ON  = 1V6    = 0.872 - 63
    // OFF - ON - OFF  = 2V5    = 1.362 - 105
    // ON - OFF - OFF  = 4V12   = 2.245 - 173
    
    if(deviceStruct.sensors.xscroll < 84) xscroll_stat = XSCROLL_RIGHT;
    else if(deviceStruct.sensors.xscroll < 139) xscroll_stat = XSCROLL_CENTER;
    else if(deviceStruct.sensors.xscroll < 191) xscroll_stat = XSCROLL_LEFT;
    else xscroll_stat = XSCROLL_UNDETECTED;
    
    
    // Detects the change in the current status
    if((StatusModeRegister.xscroll_code == xscroll_stat)){
         debounce = XSCROLL_DEBOUNCE;
         return;
    }         
    debounce--;     
    
    // Change the status
    if(debounce == 0){
        StatusModeRegister.xscroll_code = xscroll_stat;
        debounce = XSCROLL_DEBOUNCE;
        
        // Buzzer Sound Here
        return;
    }
    
    return;
}

#define YFLIP_DEBOUNCE 4 
void YFlipDetection(void){
    static int debounce = YFLIP_DEBOUNCE; // About 500ms
    
    bool input_stat = uc_YRIB_Get();
    if(input_stat == deviceStruct.Yup){
        debounce = YFLIP_DEBOUNCE;
        StatusModeRegister.y_up_detected = deviceStruct.Yup;
        return;
    }
    
    debounce--; 
    
    // Change the status
    if(debounce == 0){
        StatusModeRegister.y_up_detected = deviceStruct.Yup = input_stat;
        debounce = YFLIP_DEBOUNCE;
        
        // Buzzer Sound Here
        return;
    }
    
    return;
}

#define NEEDLE_DEBOUNCE 4 
void NeedleIdDetection(void){
    static int debounce = NEEDLE_DEBOUNCE; // About 500ms
    STATUS_NEEDLE_t needle_stat;
    
    // Reads the sensor
    ADC1_ChannelSelect( ADC_POSINPUT_AIN0, ADC_NEGINPUT_GND );
    ADC1_ConversionStart();
    while(!ADC1_ConversionStatusGet());
    deviceStruct.sensors.needle_id = (int) ADC1_ConversionResultGet();
    StatusAnalogRegister.NEEDLE_ID = deviceStruct.sensors.needle_id;
    
    // Reads the Needle Ena Enable feedback 
    // When the input is zero it means that the disable is true (power switch disabled)
    StatusModeRegister.power_sw_needle_disable = deviceStruct.needle_disable_stat = uc_NEEDLE_ENA_FEEDBACK_Get();
   

    
    // Identification Table
    // Vuc = VBoard 0.545
    // U1   -   U2  -   VBOUT   - Digit
    //---------------------------------------
    // OFF  -   OFF -   2.14V   - 90
    // OFF  -   ON  -   2.73V   - 114
    // ON   -   OFF -   3.33V   - 140
    // ON   -   ON  -   5V      - 255
    // DISCONNECTED DEVICE = 5V
    
    
    if(deviceStruct.sensors.needle_id < 102) needle_stat = NEEDLE_UNDETECTED;
    else if(deviceStruct.sensors.needle_id < 127) needle_stat = NEEDLE_A;
    else if(deviceStruct.sensors.needle_id < 200) needle_stat = NEEDLE_B;
    else{
        
        // If the Needle disable signal is present it means that the adapter is connected,
        // then this code is C. If the Needle disable signal, is not present then the 
        // adapter is not connected
        if(deviceStruct.needle_disable_stat){
             // The adapter is present
            needle_stat = NEEDLE_C;
        }else{
            needle_stat = NEEDLE_DISCONNECTED;
        }
    }
    
    
    // Detects the change in the current status
    if((StatusModeRegister.needle_code == needle_stat)){
         debounce = NEEDLE_DEBOUNCE;
         return;
    }         
    debounce--;     
    
    // Change the status
    if(debounce == 0){
        StatusModeRegister.needle_code = needle_stat;
        debounce = NEEDLE_DEBOUNCE;
        
        // Buzzer Sound Here
        return;
    }
    
    
    return;
    
}


/**
 * 
 * Convertion factor 1V -> 0.125V
 */
void MotorPowerSupplyDetection(){
    ADC1_ChannelSelect( ADC_POSINPUT_AIN9, ADC_NEGINPUT_GND );
    ADC1_ConversionStart();
    while(!ADC1_ConversionStatusGet());
    
    // Translate in 0.1V/unit 
    int val = (int) ADC1_ConversionResultGet() * 33 * 8 / 255;
    if(val>255) val = 255;
    
    deviceStruct.sensors.power_supply = (unsigned char) val;
    StatusAnalogRegister.MOTOR_POWER = deviceStruct.sensors.power_supply;
    return;
}

void GetSHSensor(){  
    
    // No detection if the needle is disconnected
    if(StatusModeRegister.needle_code == NEEDLE_DISCONNECTED){
        deviceStruct.sensors.sh = 0;
        StatusZPositionRegister.SL = 0;
        StatusZPositionRegister.SH = 0;
        return;
    }
    
    ADC0_ChannelSelect( ADC_POSINPUT_AIN0, ADC_NEGINPUT_GND );
    ADC0_ConversionStart();
    while(!ADC0_ConversionStatusGet());    
    deviceStruct.sensors.sh = (int) ADC0_ConversionResultGet();
    
    int val = deviceStruct.sensors.sh;
    if(val<0) val = 0;
    StatusZPositionRegister.SL = (unsigned char) (val & 0x00FF);
    StatusZPositionRegister.SH = (unsigned char) ((val >> 8) & 0x00FF);     
    return;
}

void KeyboardHandler(void){
    
    // Upgrades the current keyboard hardware status
    deviceStruct.keyboard.hw.xp =  uc_BUTTON_XP_Get();
    deviceStruct.keyboard.hw.xm =  uc_BUTTON_XM_Get();
    deviceStruct.keyboard.hw.yp =  uc_BUTTON_YP_Get();
    deviceStruct.keyboard.hw.ym =  uc_BUTTON_YM_Get();
    deviceStruct.keyboard.hw.zp =  uc_BUTTON_ZP_Get();
    deviceStruct.keyboard.hw.zm =  uc_BUTTON_ZM_Get();
    StatusAnalogRegister.KEYBOARD = *((unsigned char*) &deviceStruct.keyboard.hw);
    
    // Upgrade the flags
    if(StatusAnalogRegister.KEYBOARD) 
        deviceStruct.keyboard.flags.key_present = true;
    else 
        deviceStruct.keyboard.flags.key_present = false;       
    
    if(uc_BUTTON_ENA_Get()) deviceStruct.keyboard.flags.keyboard_enable_stat = true;
    else deviceStruct.keyboard.flags.keyboard_enable_stat = false;
    StatusModeRegister.power_sw_keyboard_enable = deviceStruct.keyboard.flags.keyboard_enable_stat;
    
}

void SetKeyMode(bool enable, bool step_mode){
    
    // Enabling the Power Switch control
    if(enable){ 
        uc_BUTTON_ENA_Set();
        deviceStruct.keyboard.flags.keyboard_enable_stat = true;
    }else{
        uc_BUTTON_ENA_Clear();
        deviceStruct.keyboard.flags.keyboard_enable_stat = false;
        step_mode = false; // Reset a current active step mode
    }
    StatusModeRegister.power_sw_keyboard_enable = deviceStruct.keyboard.flags.keyboard_enable_stat;
    
    // Step Mode
    StatusModeRegister.keystep_mode_enabled = deviceStruct.keyboard.flags.keystep = step_mode;
   
}

void SetPowerSwitchStat(bool stat){
    
    // General Enable Power Switch
    if(stat){
        uc_MOTOR_GENERAL_ENABLE_Set();
    }else{
        uc_MOTOR_GENERAL_ENABLE_Clear();
    }
    
    StatusModeRegister.power_sw_general_enable =  deviceStruct.general_enable_stat = stat; 
    return;
}
/** @}*/
/*******************************************************************************
 End of File
*/

